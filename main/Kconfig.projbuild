## main/Kconfig.projbuild
```kconfig
menu "Configuração do Wifi Configuration"

    config ESP_WIFI_SSID
        string "WiFi SSID"
        default "ssid"
        help
            Nome da rede Wifi.

    config ESP_WIFI_PASSWORD
        string "Senha do Wifi"
        default "minha_senha"
        help
            Senha do WiFi (WPA or WPA2).

    config ESP_MAXIMUM_RETRY
        int "Número máximo de tentativas de conexão"
        default 5
        help
            Configure o valor máximo de tentativas de conexão.
endmenu

menu "Configuração das Chaves de API"

    config OWM_API_KEY
        string "API Key da OpenWeatherMap"
        default "api_key"
        help
            Insira a chave de API gerada ao criar a conta na OWM.
    
    config IPSTACK_API_KEY
        string "API Key da IP Stack"
        default "api_key"
        help
            Insira a chave de API gerada ao criar a conta na IP Stack.
endmenu
```
